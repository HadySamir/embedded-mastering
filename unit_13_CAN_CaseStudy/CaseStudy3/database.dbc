VERSION ""

NS_ :

BS_:

BU_: ECU2_Speed_Sensor ECU1_Accelerator_CMD

BO_ 939 Speed_MSG: 1 ECU2_Speed_Sensor
 SG_ Speed : 0|8@1+ (1,0) [0|255] ""  ECU1_Accelerator_CMD

BO_ 48 ACC_CMD: 1 ECU1_Accelerator_CMD
 SG_ ACC : 0|8@1+ (1,0) [0|1] ""  ECU2_Speed_Sensor

BA_DEF_  "BusType" STRING ;
BA_DEF_DEF_  "BusType" "CAN";
